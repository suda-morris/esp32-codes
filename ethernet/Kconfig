## ethernet/Kconfig
```kconfig
menu "Ethernet PHY Support"

choice PHY_MODULE
    prompt "Ethernet PHY Module"
    default PHY_TLK110
    help
        Select the PHY module on your board.
config PHY_TLK110
    bool "TI TLK110 PHY"
    help
        Select this to use the TI TLK110 PHY
config PHY_LAN8720
    bool "Microchip LAN8720 PHY"
    help
        Select this to use the Microchip LAN8720 PHY
endchoice

choice PHY_CLOCK_MODE_CHOICE
    prompt "EMAC clock mode"
    default PHY_CLOCK_GPIO0_IN
    help
        Select external (input on GPIO0) or internal (output on GPIO0, GPIO16 or GPIO17) clock
config PHY_CLOCK_GPIO0_IN
    bool "GPIO0 input"
    help
        Input of 50MHz refclock on GPIO0
config PHY_CLOCK_GPIO0_OUT
    bool "GPIO0 output"
    help
        Output the internal 50MHz APLL clock on GPIO0
config PHY_CLOCK_GPIO16_OUT
    bool "GPIO16 output"
    help
        Output the internal 50MHz APLL clock on GPIO16
config PHY_CLOCK_GPIO17_OUT
    bool "GPIO17 output (inverted)"
    help
        Output the internal 50MHz APLL clock on GPIO17 (inverted signal)
endchoice
config PHY_CLOCK_MODE
    int
    default 0 if PHY_CLOCK_GPIO0_IN
    default 1 if PHY_CLOCK_GPIO0_OUT
    default 2 if PHY_CLOCK_GPIO16_OUT
    default 3 if PHY_CLOCK_GPIO17_OUT

config PHY_ADDRESS
    int "PHY Address"
    default 31
    range 0 31
    help
        Enter the Chip Address (0-31) for ETH PHY
        The address must be in accord with your board configuration

config PHY_SMI_MDC_PIN
    int "SMI MDC Pin"
    default 23
    range 0 33
    help
        GPIO number to use for SMI clock output MDC to PHY.

config PHY_SMI_MDIO_PIN
    int "SMI MDIO Pin"
    default 18
    range 0 33
    help
       GPIO number to use for SMI data pin MDIO to/from PHY.

if PHY_CLOCK_GPIO0_IN
config PHY_OSC_USE_EN_PIN
    bool "Use PHY Power (enable/disable) pin"
    default y
    help
        Use a GPIO "power pin" to power the PHY on/off during operation.
endif

if PHY_OSC_USE_EN_PIN
config PHY_POWER_PIN
    int "PHY Power GPIO"
    default 17
    range 0 33
    help
        GPIO number to use for powering on/off the PHY.
endif

endmenu

menu "PTP Support"

endmenu
```

## gui/Kconfig
```kconfig
menu "GUI"

############################Choice for GUI Framework##################
choice GUI_FRAMEWORK
    prompt "GUI Framework"
    default GUI_FRAMEWORK_LVGL

config GUI_FRAMEWORK_LVGL
    bool "LittlevGL"
endchoice

############################Choice for LCD Colorspace##################
choice LCD_COLORSPACE
    prompt "LCD color space"
    default LCD_COLORSPACE_R5G6B5

config LCD_COLORSPACE_R8G8B8
    bool "R8G8B8"
config LCD_COLORSPACE_R5G6B5
    bool "R5G6B5"

endchoice

############################Config of LCD Resolution#################
menu "LCD Resolution"
config LCD_X_RESOLUTION
    int "LCD X Resolution"
    range 0 1024
    default 320 
config LCD_Y_RESOLUTION
    int "LCD Y Resolution"
    range 0 1024
    default 240
endmenu

############################Choice for LCD Driver####################
menuconfig SPI_LCD
    bool "SPI LCD Support"
    default false

if SPI_LCD
choice LCD_DRIVER
    prompt "LCD Controller"
    default LCD_DRIVER_ILI9341
config LCD_DRIVER_ST7789V
    bool "ST7789V"
config LCD_DRIVER_ILI9341
    bool "ILI9341"
endchoice

menu "SPI Bus Pin Number"
config LCD_SPI_SCLK
    int "LCD CLK Pin"
    range 0 100
    default 22
config LCD_SPI_MOSI
    int "LCD MOSI Pin"
    range 0 100
    default 21
config LCD_SPI_MISO
    int "LCD MISO Pin"
    range 0 100
    default 27
endmenu
config LCD_SPI_CS
    int "LCD CS Pin"
    range 0 100
    default 5
config LCD_SPI_DC
    int "LCD DC Pin"
    range 0 100
    default 19
config LCD_SPI_RST
    int "LCD RST Pin"
    range 0 100
    default 18
config LCD_SPI_BCKL
    int "LCD BCKL Pin"
    range 0 100
    default 23
config LCD_SPI_CLK_SPEED_MHZ
    int "SPI Clock MHz"
    range 0 100
    default 20
endif

############################Choice for Touch Panel Driver#############
menuconfig SPI_TOUCH_PANEL
    bool "Touch Panel Support"
    default false

if SPI_TOUCH_PANEL
menu "SPI RTP Support"
choice RTP_DRIVER
    prompt "RTP Driver Support"
    default RTP_DRIVER_XPT2046
config RTP_DRIVER_XPT2046
    bool "XPT2046"
endchoice

config SPI_TOUCH_PIN_SAME_LCD
    bool "Touch Panel's SPI Bus Same to LCD"
    default true

if !SPI_TOUCH_PIN_SAME_LCD
menu "SPI Bus Pin Number"
config RTP_SPI_SCLK
    int "RTP CLK Pin"
    range 0 100
    default 22
config RTP_SPI_MOSI
    int "RTP MOSI Pin"
    range 0 100
    default 21
config RTP_SPI_MISO
    int "RTP MISO Pin"
    range 0 100
    default 27
endmenu
endif

config RTP_SPI_IRQ
    int "RTP Interrupt Pin"
    range 0 100
    default 33
config RTP_SPI_CS
    int "RTP CS Pin"
    range 0 100
    default 32

config RTP_SPI_CLK_SPEED_MHZ
    int "SPI Clock MHz"
    range 0 100
    default 1

endmenu
config TOUCH_SWAP_X_Y
    bool "Swap X with Y"
    default true
endif

endmenu
```

## nmea-parser/Kconfig
```kconfig
menu "NMEA Parser"

config NMEA_PARSER_BUFFER_SIZE
int "Size of Internel Buffer Used for NMEA Parser"
range 0 2048
default 1024

config NMEA_TASK_STACK_SIZE
int "nmea_parser task stack size"
range 0 10240
default 2048

config NMEA_TASK_PRIORITY
int "nmea_parser task's priority"
range 0 24
default 2

menu "UART Configuration"
config RECEIVER_BAUDRATE
int "Baud Rate of GPS Receiver"
range 0 115200
default 9600

config UART_PINS_RX
int "Pin Num of UART-RX"
range 0 100
default 5

config UART_PORT_NUM
int "UART Port Number"
range 0 2
default 1
endmenu

config MAX_SATELLITES_IN_VIEW
int "Maximum Amount of Visible Satellites"
range 20 30
default 12

config GPS_TIME_ZONE
int "GPS Time Zone"
range -12 12
default 8

menu "NMEA Statements"
config NMEA_STATEMENT_GGA
    bool "GGA Statement"
    default y
    help
        This statement must be enabled to parse:
            Latitude, Longitude, Altitude
            Number of satellites in use, fix (no fix, GPS, DGPS), UTC time
config NMEA_STATEMENT_GSA
    bool "GSA Statement"
    default y
    help
        This statement must be enabled to parse:
            Position/Vertical/Horizontal dilution of precision
            Fix mode (no fix, 2D, 3D fix)
            IDs of satellites in use
config NMEA_STATEMENT_GSV
    bool "GSV Statement"
    default y
    help
        This statement must be enabled to parse:
            Number of satellites in view
            Optional details of each satellite in view.
config NMEA_STATEMENT_RMC
    bool "RMC Statement"
    default y
    help
        This statement must be enabled to parse:
            Validity of GPS signal
            Ground speed in knots and coarse in degrees
            Magnetic variation
            UTC date
endmenu

endmenu
```

## template/examples/main/Kconfig.projbuild
```kconfig
menu "Example Configuration"

config WIFI_SSID
string "WiFi SSID"
default "Xiaomi_024D_plus"

config WIFI_PASSWORD
string "WiFi Password"
default "321woaini"

endmenu
```
